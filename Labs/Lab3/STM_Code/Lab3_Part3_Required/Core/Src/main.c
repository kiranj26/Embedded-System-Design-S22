/*****************************************************************************
 * Copyright (C) 2023 by Kiran Jojare
 *
 * Redistribution, modification or use of this software in source or binary
 * forms is permitted as long as the files maintain this copyright. Users
 * are permitted to modify this and use it to learn about the field of
 * embedded software. Kiran Jojare and the University of Colorado are not
 * liable for any misuse of this material.
 *****************************************************************************/

/**
 * @file    main.c
 * @brief   Main file for Lab3 Part3 STM Part
 *
 * This program controls the duty cycle of a PWM signal generated by a timer.
 * It uses an external button to increase or decrease the duty cycle by 10%
 * and also accepts commands from the UART to set the duty cycle to a specific value.
 * The program is written for the STM32F4 Discovery board and uses the STM32F407VG microcontroller.
 *
 * @author  Kiran Jojare
 * @date    March 18, 2023
 * @version 1.0
 *
 * @@referense
 *   1) https://github.com/fcayci/stm32f4-bare-metal
 *
 */

#include <stdio.h>
#include <stdint.h>
#include <string.h>
#include "stm32f4xx.h"

#include "switch.h"
#include "clock.h"
#include "PWM.h"
#include "UART.h"


/* Global variables */
volatile uint8_t Button_PA0_press = 0;                 // Flag to indicate button press
volatile uint16_t current_duty_cycle = 500;            // Current duty cycle of PWM signal
volatile uint8_t increase_duty_cycle = 1;              // Flag to indicate increasing duty cycle
volatile uint8_t char_increase_duty_cycle = 1;         // Flag to indicate increasing duty cycle when receiving UART commands

volatile char rx_buffer[100];                          // UART receive buffer
volatile int rx_head = 0;                              // Head index of UART receive buffer
volatile int rx_tail = 0;                              // Tail index of UART receive buffer

char str[1000];                                          // Character buffer for printing messages
char dec[100];                                          // Character buffer for converting integers to strings

/**
 * @brief Processes the received UART command and updates the duty cycle accordingly.
 */

void duty_cycle_processing(void)
{
    char c = rx_buffer[rx_tail++];                      // Get the next character from UART receive buffer
    if (c == 'A')                                      // If 'A' is received, increase duty cycle by 50
    {
    	strcpy(str, "\n\rCharacter A Detected\n\r");
    	my_putstring(str);
    	strcpy(str, "\n\Increasing duty cycle by 5% \n\r\n\r");
    	my_putstring(str);
        current_duty_cycle += 50;
        if (current_duty_cycle >= 1000) {
            // Reached maximum duty cycle, set to 1000 and stop increasing
            current_duty_cycle = 1000;
        }
    }
    if (c == 'B')                                      // If 'B' is received, decrease duty cycle by 50
    {
    	strcpy(str, "\n\rCharacter B Detected\n\r");
    	my_putstring(str);
    	strcpy(str, "\n\Decreasing duty cycle by 5% \n\r\n\r");
    	my_putstring(str);
        current_duty_cycle -= 50;
        if (current_duty_cycle == 0) {
            // Reached minimum duty cycle, set to 0 and stop decreasing
            current_duty_cycle = 0;
        }
    }
    if (c == 'P')                                      // If 'P' is received, print current duty cycle
    {
    	strcpy(str, "\n\rCharacter P Detected\n\r");
    	my_putstring(str);
    	strcpy(str, "\n\Printing current cycle !\n\r");
    	my_putstring(str);
        sprintf(dec, "%d", current_duty_cycle/10);     // Convert duty cycle to string
        strcpy(str, "\n\rCurrent Duty Cycle = ");      // Print message
        strcat(dec," % \n\r");
        strcat(str,dec);
        my_putstring(str);
    }
    TIM4->CCR4 = current_duty_cycle;                    // Update the duty cycle of TIM4
}

void Error_Handler(void) {

	__disable_irq();
	while (1) {
	}
}


/**
 * @brief Interrupt handler for EXTI0. Processes button press and updates duty cycle.
 */
void EXTI0_IRQHandler(void) {

  for(int i=0;i<100000;i++){}
  // Clear the interrupt flag
  EXTI->PR |= EXTI_PR_PR0;

  // Print message indicating button press
  strcpy(str, "\n\rButton Pressed!\n\r");
  my_putstring(str);

  // Increase or decrease duty cycle by 10%
  if (increase_duty_cycle) {
    // Increase duty cycle
    strcpy(str, "Increasing Duty Cycle !\n\r");
    my_putstring(str);
    current_duty_cycle += 100;
    sprintf(dec, "%d", current_duty_cycle);
    strcpy(str, "Current Duty Cycle = ");
    strcat(str,dec);
    my_putstring(str);
    // Check if maximum duty cycle is reached
    if (current_duty_cycle >= 1000) {
      // Reached maximum duty cycle, start decreasing
      strcpy(str, "\n\r!! Max Duty Cycle Reached !!\n\r");
      my_putstring(str);
      increase_duty_cycle = 0;
    }
  } else {
    // Decrease duty cycle
    strcpy(str, "Decreasing Duty Cycle !\n\r");
    my_putstring(str);
    current_duty_cycle -= 100;
    sprintf(dec, "%d", current_duty_cycle);
    strcpy(str, "Current Duty Cycle = ");
    strcat(str,dec);
    my_putstring(str);
    // Check if minimum duty cycle is reached
    if (current_duty_cycle == 0) {
      // Reached minimum duty cycle, start increasing
      strcpy(str, "\n\r!! Min Duty Cycle Reached !!\n\r");
      my_putstring(str);
      increase_duty_cycle = 1;
    }
  }

  // Update the duty cycle of TIM3
  TIM4->CCR4 = current_duty_cycle;
}
/**
 * @brief Interrupt handler for USART2. Handles received data and stores in buffer.
 */
void USART2_IRQHandler(void)
{
    // Check if receive interrupt flag is set
    if (USART2->SR & USART_SR_RXNE )
    {
        rx_buffer[rx_head++] = USART2->DR; // Store received byte
        // No need to clear flag since it is cleared by a read
    }
}

/**
 * @brief Main function that initializes clock, switches, PWM, and UART. Receives data and processes duty cycle.
 */
int main(void) {
    // Initialize clock and peripherals
    Clock_init();
    Switch_init();
    PWM_GPIO_init();
    PWM_init();
    Uart_init();
    // Print welcome message
    printf("\n\r\n\rHello! Welcome to Lab3 Part3 STM32F4 PWM program\n\r");
    printf("After every switch press, duty cycle will be incremented by 10%% until it reaches its maximum value of 100%%, and then decremented by 10%% until it reaches its minimum value of 0%%.\n\r");
    printf("If 'A' is available on UART, duty cycle will be incremented by 5%%.\n\r");
    printf("If 'B' is available on UART, duty cycle will be decremented by 5%%.\n\r");
    printf("If 'P' is available on UART, the current duty cycle will be printed.\n\r");

    while (1) {
        // Check for received data
        if (rx_tail < rx_head) {
            my_putchar(rx_buffer[rx_tail++]);
            duty_cycle_processing();
        } else if (rx_tail == rx_head) {
            // Reset tail and head if buffer is empty
            rx_tail = rx_head = 0;
        }
    }
}
